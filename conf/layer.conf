## conf/layer.conf
```bitbake
# We have a conf and classes directory, add to BBPATH
BBPATH .= ":${LAYERDIR}"

# We have recipes-* directories, add to BBFILES
BBFILES += "${LAYERDIR}/recipes-*/*/*.bb \
	    ${LAYERDIR}/recipes-*/*/*.bbappend"

BBFILE_COLLECTIONS += "meta-kentkart"
BBFILE_PATTERN_meta-kentkart = "^${LAYERDIR}/"
BBFILE_PRIORITY_meta-kentkart = "9"


BBMASK += "meta-freescale/recipes-graphics/clutter/clutter-1.0_%.bbappend"
BBMASK += "meta-freescale/recipes-graphics/cogl/cogl-1.0_%.bbappend"
BBMASK += "meta-freescale/recipes-graphics/mesa/mesa-demos_%.bbappend"
BBMASK += "meta-freescale/recipes-graphics/xorg-driver/xf86-video-imxfb-vivante_5.0.11.p8.6.bb"

HOSTTOOLS_NONFATAL_append = " sha384sum"

# Let us add layer-specific bbappends which are only applied when that
# layer is included in our configuration
#BBFILES += "${@' '.join('${LAYERDIR}/%s/recipes*/*/*.bbappend' % layer \
#              for layer in BBFILE_COLLECTIONS.split())}"

# Add layer-specific bb files too
#BBFILES += "${@' '.join('${LAYERDIR}/%s/recipes*/*/*.bb' % layer \
#               for layer in BBFILE_COLLECTIONS.split())}"
```
